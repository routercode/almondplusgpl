## openwrt-2.4.2011-trunk/target/linux/ag2/eng/defconfig
```kconfig
# Non-package opwnwrt .config stuff to add for this board,
# for all profiles.  
CONFIG_BUSYBOX_CONFIG_RESIZE=y
CONFIG_BUSYBOX_CONFIG_GETTY=y
CONFIG_BUSYBOX_CONFIG_LOGIN=y
CONFIG_PACKAGE_hotplug2=n
CONFIG_CS_UBOOT_MORE_ARGS="SB_PHY=PPPS"
CONFIG_KERNEL_PCIE_NUM_PORTS=3
```

## openwrt-2.4.2011-trunk/target/linux/ag2/files/arch/arm/mach-goldengate/Kconfig
```kconfig
menu "Cortina-System platform type"
	depends on ARCH_GOLDENGATE

config MACH_CORTINA_G2
	bool "Support Cortina-System G2 platform"
	select ARM_GIC
	select CPU_V7
	help
	  Include support for Cortex-A9 CPU on Cortina-Systems Baseboard.

choice
	prompt "G2 Platform Type"
	default CORTINA_FPGA
	help
  	  Pick the G2 platform to build

config CORTINA_FPGA
       bool "FPGA Verification Board"
       help
         Support for the Golden-Gate FPGA board.

config CORTINA_ENGINEERING
       bool "Engineering Board"
       help
         Support for the Golden-Gate engineering board.

config CORTINA_REFERENCE
       bool "Reference Board"
       help
         Support for the Golden-Gate reference board.

endchoice

config ACP
        bool "Support ACP(Accelerator Coherency Port)"
        depends on MACH_CORTINA_G2 && !CORTINA_FPGA
        help
          Support for the Golden-Gate ASIC. The Accelerator Coherency Port (ACP) is a feature
          of Cortex-A9, which provides an AXI slave port that can be connected to a DMA engine,
          providing the DMA access to the SCU of Cortex-A9. Addresses on the ACP port are physical
          addresses which can be snooped by the SCU to provide full I/O coherency.

config PLATFORM_APB_CLK
        int "Default APB clock speed(MHZ)"
        default "100"
        depends on MACH_CORTINA_G2 && !CORTINA_FPGA
        help
          There are three different APB clock for different HW strap pin.
          100 for CPU clock 400, 600, 700, 800 and 900 MHz(Strap 0~4)
          150 for CPU clock 750 MHz(Strap 5)
          170 for CPU clock 850 MHz(Strap 6)

config CS75XX_SSP
        bool "Support SSP(Synchronous Serial Port)"
        depends on MACH_CORTINA_G2
        help
          SSP can send PCM voice data for SLIC or I2C audio data to DAC.

menuconfig CORTINA_G2_PCIE
	bool "Support Cortina-System G2 PCIe "
	select PCI
	select ARCH_SUPPORTS_MSI
	select PCI_SYSCALL
	select PCI_MSI
	select PCI_LEGACY
  help
	  Include support PCIe for Cortex-A9 CPU on Cortina-Systems Baseboard.

if CORTINA_G2_PCIE
config PCIE_NUM_PORTS
        int "Numer of PCIe Root Complex ports, 1, 2, 3"
        depends on CORTINA_G2_PCIE=y
        default "2"
        help
          Number of Root Complex ports supportted by PCIe.
endif

config CORTINA_G2_USB_HOST
	bool "Support Cortina-System G2 USB Host driver"
	select USB_ARCH_HAS_EHCI
	select USB_ARCH_HAS_OHCI
  help
	  Include support USB host for Cortex-A9 CPU on Cortina-Systems Baseboard.

endmenu
```

## openwrt-2.4.2011-trunk/target/linux/ag2/files/drivers/cs752x/Kconfig
```kconfig
menu "Cortina Systems Goldengate SOC drivers"

config CS752X_PROC
       bool "Turn on debugging features"
       select PRINTK
       select PROC_FS
       default y
       help
         Allow users to control CS752X debug flags and other variables 
         from proc filesystems.
         They are allocated in /proc/drivers/cs752x/*.

source "drivers/cs752x/ni/Kconfig"

config CS752X_AHCI
       tristate "AHCI Serial ATA"
       select ATA
       help
	This option enables support for Golden-Gate AHCI Serial ATA.

source "drivers/cs752x/char/Kconfig"

config GPIO_CS75XX
       tristate "G2 GPIO support"
       select GPIOLIB
       help
	Goldengate GPIO sub-system

config I2C_CS75XX
       tristate "I2C(BIW) controller"
       select I2C
       select I2C_BOARDINFO
       help
         Built-in I2C interface on the Cortina CS75XX of host bridges.

source "drivers/cs752x/lcd/Kconfig"

config RTC_DRV_G2
       tristate "Real Time Clock support"
       select RTC_CLASS
       help
         Support for the RTC found on the GoldenGate Soc.

source "drivers/cs752x/sd/Kconfig"

source "drivers/cs752x/spdif/Kconfig"

config SPI_CS75XX
       tristate "SPI Master support"
       select SPI
       select SPI_MASTER
       help
	 This enables using the SPI master controller on the CS75XX chips

config SPI_AGENT
       tristate "SPI device agent"
       depends on SPI_CS75XX
       help
         This supports SPI slave drivers.

source "drivers/cs752x/media/Kconfig"

config G2_WATCHDOG
       tristate "Watchdog Timer"
       select WATCHDOG
       help
         Watchdog timer block in Goldengate chips. This will
  	 reboot the system when the timer expires with the watchdog
  	 enabled.

source "drivers/cs752x/mtd/Kconfig"

config CORTINA_G2_ADMA
        tristate "Cortina G2 ADMA support"
        select DMA_ENGINE
        help
          Enable support for the Cortina-Systems(R) CS75xx Series built-in DMA engines.

config SERIAL_CORTINA
        bool "CORTINA serial port support"
        select SERIAL_CORE
        help
          If you have a board based on a Cortina, you
          can enable its onboard serial port by enabling this option.

config SERIAL_CORTINA_CONSOLE
        bool "Console on CORTINA serial port"
        depends on SERIAL_CORTINA=y
        select SERIAL_CORE_CONSOLE
        help
          If you have enabled the serial port on the Cortina baseboard
          you can make it the console by answering Y to this option.

          Even if you say Y here, the currently visible virtual console
          (/dev/tty0) will still be used as the system console by default, but
          you can alter that using a kernel command line option such as
          "console=ttyS0". (Try "man bootparam" or see the documentation of
          your boot loader (lilo or loadlin) about how to pass options to the
          kernel at boot time.)

source "drivers/cs752x/telephony/Kconfig"

endmenu
```

## openwrt-2.4.2011-trunk/target/linux/ag2/files/drivers/cs752x/char/Kconfig
```kconfig
menu "Character Devices"
     depends on ARCH_GOLDENGATE

config CS75XX_CIR
        tristate "Cortina CS75XX Consumer Infrared"
        depends on ARCH_GOLDENGATE
        help
          Say Y here if you want to use Cortina CS75XX Consumer Infrared
          (CIR) 

config CS75XX_PWC
        tristate "Cortina CS75XX power supply"
        depends on ARCH_GOLDENGATE
        help
          Say Y here to enable support for the power control provided by the
          Cortina CS75XX.

config CS75XX_REG_RW
        tristate "Cortina CS75XX Read/Write Register "
        help
              Support to read/write register in command line for 
              Cortex-A9 CPU on Cortina-Systems Baseboard.          

config HW_RANDOM_CS75XX
        tristate "Cortina CS75XX Random Number Generator support"
        depends on ARCH_GOLDENGATE
        select HW_RANDOM
        ---help---
          This driver provides kernel-side support for the Random Number
          Generator hardware found on CS75XX Gate processors.

          To compile this driver as a module, choose M here: the
          module will be called cs75xx-rng.

          If unsure, say Y.

menu "Configuration"
	depends on HW_RANDOM_CS75XX

config TRNG_DIAG_ON
	bool "Diagnostics"
	default n
	help
	  Turn on diagnostics
endmenu

endmenu
```

## openwrt-2.4.2011-trunk/target/linux/ag2/files/drivers/cs752x/lcd/Kconfig
```kconfig
menu "Display Panel"
     depends on ARCH_GOLDENGATE

     config FB_CS752X_CLCD
     	tristate "Driver for LCD controller"
	select FB
        select FB_CFB_FILLRECT
        select FB_CFB_COPYAREA
        select FB_CFB_IMAGEBLIT
	help
	  Driver for on-chip ARM PrimeCell PL111 colour LCD controller

     choice
	depends on FB_CS752X_CLCD
	prompt "CS752X color LCD FPGA/SOC switch"
	default FB_CS752X_CLCD_FPGA

	config FB_CS752X_CLCD_FPGA
               bool "CS752X LCD FPGA 10MHz"
	config FB_CS752X_CLCD_SOC
               bool "CS752X LCD SOC 150MHz"
     endchoice

     choice
	depends on FB_CS752X_CLCD
        prompt "CS752X color LCD RGB selection"
        default FB_CS752X_CLCD_RGB888

	config FB_CS752X_CLCD_RGB888
               bool "pixel format RGB888"
	config FB_CS752X_CLCD_RGB565
               bool "pixel format RGB565"
     endchoice

     config HDMI_ANX9805
      	tristate "ANX9805 HDMI Transmitter"
	select I2C
	select I2C_CS75XX
      	depends on (SOUND_CS75XX_SPDIF || FB_CS752X_CLCD)
        default n
      	help
          Say Y here if you have ANX9805 client hooked to an I2C bus.
	  
          The cs75xx supports hdmi features. It uses anx9805 hdmi transmitter
          for tramsmission. It depends on I2C bus.

     config HDMI_ANX9805_GPIO_INTERRUPT
        bool "ANX9805 GPIO Interrupt"
        depends on HDMI_ANX9805
        default n
        help
          Say Y here if you want to support gpio interrupt for hdmi
          transmitter.

     config HDMI_ANX9805_DEBUG
        bool "ANX9805 Debugging"
        depends on HDMI_ANX9805
        default n
        help
          Say Y here if you want to debug anx9805 hdmi driver.

     choice
	depends on FB_CS752X_CLCD
        prompt "CS752X color LCD panel selection"
        default PANEL_HX8238A

     	config FB_PANEL_AT056TN53
               bool "Innolux AT056TN53 TFT panel"
               help
                 640x(RGB)x480, 24-bit RGB

	config PANEL_HX8238A
	       select SPI_CS75XX
               bool "HX8238A panel"
               help
                 Say Y here if you have HX8238A hooked to a spi bus.

          	 The HX8238A is a controller and driver which can
          	 drive a maximum 320x240 pixel graphics on a TFT
          	 panel displays in 262K colors. It depends on SPI bus.

	config HDMI_VIDEO_ANX9805
      	       bool "ANX9805 hdmi virtual video panel"
      	       depends on HDMI_ANX9805 && FB_CS752X_CLCD_RGB888
      	       help
		Say Y here if you have ANX9805 hooked to a i2c bus.
		
		The ANX9805 is a digital video transmitter that supports the HDMI
        	digital interface. The device is fully compliant to the HDMI 1.3
        	with HDCP content protection. It depends on I2C bus.

     endchoice

     config FB_CS752X_CLCD_PINGPONG_BUFFER
      	depends on FB_CS752X_CLCD
        bool "Enable ping-pong buffer"
        default y

     config FB_CS752X_CLCD_POLLING_FB
        bool "Enable ping-pong buffer polling"
	depends on FB_CS752X_CLCD_PINGPONG_BUFFER
        default y

     config FB_CS752X_CLCD_NO_AMBA_PCLK
      	depends on FB_CS752X_CLCD
        bool "Disable the AMBA clock"

     config FB_CS752X_CLCD_DEBUG
      	depends on FB_CS752X_CLCD
        bool "Debug messages for CS752X color LCD Driver"
        default n
        help
          LCD Debugging Selection

     config FB_CS752X_CLCD_AUTOPLAY
        bool "Test Framebuffer Ping-pong Autoplay"
        depends on FB_CS752X_CLCD_DEBUG && FB_CS752X_CLCD_PINGPONG_BUFFER
        default n
        help
          LCD Debugging Selection

endmenu
```

## openwrt-2.4.2011-trunk/target/linux/ag2/files/drivers/cs752x/media/Kconfig
```kconfig
config DVB_CS75XX_TS
       tristate "Transport Stream support"
       select MEDIA_SUPPORT
       select DVB_CORE
       select DVB_CAPTURE_DRIVERS
       help
	 Since this module have no MPEG decoder onboard, they transmit
  	 only compressed MPEG data over the AXI bus, so you need
  	 an external software decoder to watch TV on your computer.
```

## openwrt-2.4.2011-trunk/target/linux/ag2/files/drivers/cs752x/mtd/Kconfig
```kconfig
menu "Flash support"
     depends on ARCH_GOLDENGATE

source "drivers/cs752x/mtd/maps/Kconfig"

config MTD_CORTINA_CS752X_NAND
        tristate "NAND Flash device on Cortina board"
	select MTD
	select MTD_NAND
        help
          This enables the driver for the Cortina board to 
          access the nand device.

choice
        prompt "G2 Hardware ECC Mode"
        depends on MTD_CORTINA_CS752X_NAND
        default CS752X_NAND_ECC_HW_HAMMING_256
        help
          This option enables the error correction provides hardware

config CS752X_NAND_ECC_HW_HAMMING_256
        bool "NAND Flash HW Hamming ECC (256) on Cortina board"
        help
          This enables the driver for the Cortina board to 
          access the nand device with Hamming ecc.
          This option tolerates 1 bit error in 256 data

config CS752X_NAND_ECC_HW_HAMMING_512
        bool "NAND Flash HW Hamming ECC (512) on Cortina board"
        help
          This enables the driver for the Cortina board to 
          access the nand device with Hamming ecc.
          This option tolerates 1 bit error in 512 data

config CS752X_NAND_ECC_HW_BCH_8_512
        bool "NAND Flash HW BCH ECC (8/512) on Cortina board"
        help
          This enables the driver for the Cortina board to 
          access the nand device with BCH ecc. This option 
          tolerates 8 bit error in 512 data

config CS752X_NAND_ECC_HW_BCH_12_512
        bool "NAND Flash HW BCH ECC (12/512) on Cortina board"
        help
          This enables the driver for the Cortina board to 
          access the nand device with BCH ecc. This option 
          tolerates 12 bit error in 512 data

endchoice

endmenu
```

## openwrt-2.4.2011-trunk/target/linux/ag2/files/drivers/cs752x/mtd/maps/Kconfig
```kconfig
menu "Mapping drivers for chip access"
     depends on ARCH_GOLDENGATE

config MTD_CORTINA_CS752X_CFI
        tristate "CFI Flash device mapped on CORTINA_G2"
        select MTD_CFI
        help
          Map driver for CORTINA_G2 demo board.

config MTD_CORTINA_CS752X_PFLASH_SIZE
        hex "Parallel flash size on board."
        depends on MTD_CORTINA_CS752X_CFI
        default "0x8000000"
        help
          Set flash size on board. Default size is 128MB.

config MTD_CORTINA_CS752X_SERIAL_ATMEL
        tristate "ATMEL Serial Flash device mapped on CORTINA_G2"
	select MTD
        select MTD_PARTITIONS
        help
          Map driver for CORTINA_G2 demo board.

config MTD_CORTINA_CS752X_SERIAL_SPANSION
        tristate "SPANSION Serial Flash device mapped on CORTINA_G2"
	select MTD
        select MTD_PARTITIONS
        help
          Map driver for CORTINA_G2 reference board.

config MTD_CORTINA_CS752X_SERIAL_ST
        tristate "ST Serial Flash device mapped on CORTINA_G2"
	select MTD
        select MTD_PARTITIONS
        help
          Map driver for CORTINA_G2 demo board.          

config CORTINA_CS752X_SHARE_PIN
        tristate "Parallel Flash share pin on CORTINA_G2 ASIC"
        depends on MACH_CORTINA_G2

endmenu
```
