## openwrt-2.4.2011-trunk/target/linux/ag2/files/drivers/cs752x/ni/Kconfig
```kconfig
menu "Networking"
     depends on ARCH_GOLDENGATE

config CS752X
        tristate "Cortina CS752X Gigabit Ethernet support"
	select NETDEV_1000
        ---help---
          This driver supports Cortina CS752x gigabit ethernet family of
          adapters.  For more information on how to identify your adapter, go
          to the Adapter & Driver ID Guide at:

          <http://www.cortina-systems.com/>

if CS752X

config CS752X_HW_INTERNAL_BUFFERS
        bool "Cortina CS752X Hardware Internal Buffers - 256kB"
	default y
        depends on CS752X
        ---help---
          When set gigabit ethernet ports and internal recirculation ports will
          use onchip memory.  This removes DDR bandwidth consumption for packets
          destined for those ports or sourced from them.
          For more information on how to identify your adapter, go
          to the Adapter & Driver ID Guide at:

          <http://www.cortina-systems.com/>


config CS752X_HW_INTERNAL_BUFFERS_HALF_SIZE
        bool "Cortina CS752X HW HALF SIZE Internal Buffers 128kB instead"
	default n
        depends on CS752X_HW_INTERNAL_BUFFERS
        ---help---
	  When set the lower half of the memory will be used for the queue manager
	  and the upper half of memory will be available to CPUs or whatever 
	  purpose desired. This means that the buffer depth also for the QM
	  will be 128kB instead of the larger 256kB and may suffer from
	  dropped packets on jumbo sized frames when all ports are active.
	  
          For more information on how to identify your adapter, go
          to the Adapter & Driver ID Guide at:

          <http://www.cortina-systems.com/>

config CS752X_HW_INTERNAL_BUFFERS_192_SIZE
        bool "Cortina CS752X HW HALF SIZE Internal Buffers 192kB instead"
	default n
        depends on CS752X_HW_INTERNAL_BUFFERS
        ---help---
	  When set 192kB of Packet buffer memory will be used for packet 
	  storage.  The remaining 64kB is available for general purpose CPU
	  or Recirculation Engine processing.
	  
          For more information on how to identify your adapter, go
          to the Adapter & Driver ID Guide at:

          <http://www.cortina-systems.com/>

config CS752X_HW_INTERNAL_BUFFERS_RECIRCULATION
        bool "Cortina CS752X HW Recirculation Internal Buffers"
	default n
        depends on CS752X_HW_INTERNAL_BUFFERS
        ---help---
	  Will use onchip shared internal buffers for recirculation engine
	  instead of the external.  The advantage is a saving of B/W for
	  traffic that is destined for the recirculation engine.  The
	  disadvantage is that the queue depth is very shallow so if the
	  recirculation engine task is complex and takes time packets may
	  drop.
	  
          For more information on how to identify your adapter, go
          to the Adapter & Driver ID Guide at:

          <http://www.cortina-systems.com/>


config CS752X_HW_ACCELERATION
        tristate "Cortina CS752X Hardware Acceleration support"
	default n
        depends on CS752X
        ---help---
          This driver supports Cortina CS752x chip family of hardware acceleration
          adapters.  For more information on how to identify your adapter, go
          to the Adapter & Driver ID Guide at:

          <http://www.cortina-systems.com/>

config CS752X_HW_ACCELERATION_IPSEC
        tristate "Cortina CS752X Hardware IPsec Acceleration support"
	default n
        depends on CS752X && CS752X_HW_ACCELERATION
        ---help---
          This driver supports Cortina CS752x chip family of hardware acceleration
          adapters.  For more information on how to identify your adapter, go
          to the Adapter & Driver ID Guide at:

          <http://www.cortina-systems.com/>

config CS752X_VIRTUAL_NETWORK_INTERFACE
        bool "Cortina CS752X Virtual Network Interface"
        default n
        depends on CS752X
        ---help---
          This driver supports Cortina CS752x chip family of built-in virtual
          network interfaces. For more information on how to identify your
          adapter, go to the Adapter & Driver ID Guide at:

          <http://www.cortina-systems.com/>

choice
        prompt "Attribute that Virtual Interfaces based on"
        default CS752X_VIRTUAL_NI_CPUTAG
        depends on CS752X && CS752X_VIRTUAL_NETWORK_INTERFACE

config CS752X_VIRTUAL_NI_CPUTAG
        bool "Realtek CPU TAG at the end of packet"
        help
          This will create the virtual interfaces that based on the port_mask
          in Realtek CPU tag that is appended at the end of each packet.

config CS752X_VIRTUAL_NI_DBLTAG
        bool "SVLAN tag that is always at the outer VLAN tag"
        help
          This will create the virtual interfaces that based on the VLAN ID
          of outer VLAN (SVLAN) header in each packet.

endchoice

config CS752X_VIRTUAL_ETH0
        bool "Cortina CS752X Virtual Network Interface on eth0 (MAC#0)"
        default n
        depends on CS752X && CS752X_VIRTUAL_NETWORK_INTERFACE
        ---help---
          This driver supports Cortina CS752x chip family of built-in virtual
          network interfaces on eth0.

config CS752X_NR_VIRTUAL_ETH0
        int "Number of Virtual Interfaces created on eth0 (1-80)"
        range 1 80
        default "4"
        depends on CS752X && CS752X_VIRTUAL_NETWORK_INTERFACE && \
                CS752X_VIRTUAL_ETH0

config CS752X_VID_START_ETH0
        int "The starting VLAN ID for the virtual interfaces (1 - 255)"
        range 1 255
        default "100"
        depends on CS752X && CS752X_VIRTUAL_NETWORK_INTERFACE && \
                CS752X_VIRTUAL_ETH0 && CS752X_VIRTUAL_NI_DBLTAG

config CS752X_VIRTUAL_ETH1
        bool "Cortina CS752X Virtual Network Interface on eth1 (MAC#1)"
        default n
        depends on CS752X && CS752X_VIRTUAL_NETWORK_INTERFACE
        ---help---
          This driver supports Cortina CS752x chip family of built-in virtual
          network interfaces on eth1.

config CS752X_NR_VIRTUAL_ETH1
        int "Number of Virtual Interfaces created on eth1 (1-80)"
        range 1 80
        default "4"
        depends on CS752X && CS752X_VIRTUAL_NETWORK_INTERFACE && \
                CS752X_VIRTUAL_ETH1

config CS752X_VID_START_ETH1
        int "The starting VLAN ID for the virtual interfaces (1 - 255)"
        range 1 255
        default "100"
        depends on CS752X && CS752X_VIRTUAL_NETWORK_INTERFACE && \
                CS752X_VIRTUAL_ETH1 && CS752X_VIRTUAL_NI_DBLTAG

config CS752X_VIRTUAL_ETH2
        bool "Cortina CS752X Virtual Network Interface on eth2 (MAC#2)"
        default n
        depends on CS752X && CS752X_VIRTUAL_NETWORK_INTERFACE
        ---help---
          This driver supports Cortina CS752x chip family of built-in virtual
          network interfaces on eth2.

config CS752X_NR_VIRTUAL_ETH2
        int "Number of Virtual Interfaces created on eth2 (1-80)"
        range 1 80
        default "4"
        depends on CS752X && CS752X_VIRTUAL_NETWORK_INTERFACE && \
                CS752X_VIRTUAL_ETH2

config CS752X_VID_START_ETH2
        int "The starting VLAN ID for the virtual interfaces (1 - 255)"
        range 1 255
        default "100"
        depends on CS752X && CS752X_VIRTUAL_NETWORK_INTERFACE && \
                CS752X_VIRTUAL_ETH2 && CS752X_VIRTUAL_NI_DBLTAG

config CS75XX_FE_TBL_MGMT_UT
        tristate "Unit Test of FE Table Management support"
	default n
        depends on CS752X
        ---help---
          This module support to test table management funtions of 
          forwarding engine. It covers basic test, boundary test, mixed
          operations, and combination of multiple tables.

endif
endmenu
```

## openwrt-2.4.2011-trunk/target/linux/ag2/files/drivers/cs752x/sd/Kconfig
```kconfig
menu "SD card reader support"
     depends on ARCH_GOLDENGATE

     config CS752X_SD
     	    tristate "SD card driver"
	    select CONFIG_MMC
	    select CONFIG_MMC_BLOCK
	    help
	      Goldengate SD card reader drivers.

    config CS752X_SD_25MHZ
    	   depends on CS752X_SD
           bool "SD host operating at 25MHz"
           default n
           help
             This configure will change the operation frequency of sd host
             controller to 25MHz.

    config CS752X_SD_DEBUG
    	   depends on CS752X_SD
    	   select MMC_DEBUG
           bool "Enable printing SD driver debug message"
           default n
           help
             If you want to print the sd driver debugging message, enable the option.

    config CS752X_SD_REQUEST_ONEPAGE
	   depends on CS752X_SD_DEBUG
           bool "Perform one page data transfer only"
           default n
           help
             If you want to perform one page (4096 byte) data transfer, enable the option.

endmenu
```

## openwrt-2.4.2011-trunk/target/linux/ag2/files/drivers/cs752x/spdif/Kconfig
```kconfig
menu "CS75XX SPDIF module support"
     depends on ARCH_GOLDENGATE

config SOUND_CS75XX_SPDIF
       tristate "Enable SPDIF sound support"
       select SOUND
       select SOUND_PRIME
       help
	 OSS sound driver for CS752X

config SOUND_DAC_SSP
      tristate "DAC with CS75XX SSP"
      depends on SOUND_CS75XX_SPDIF
      help
        Answer Y if you have DAC with with Cortina CS75XX SSP(I2S) module
        support.

choice
      prompt "DAC Reference Clock Selection"
      default DAC_REF_EXTERNAL_CLK
      depends on SOUND_DAC_SSP
      help
        Select the clock source.

      config DAC_REF_EXTERNAL_CLK
              bool "external clock"

      config DAC_REF_INTERNAL_CLK
              bool "internal clock"
endchoice

config SOUND_D2_45057
      tristate "D2-45057"
      depends on SOUND_PRIME!=n && SOUND!=n && ARCH_GOLDENGATE && CORTINA_ENGINEERING
      help
        Answer Y if you have D2-45057 with with Cortina CS75XX SPDIF module
        support.

choice
      prompt "D2-45057 Data Path Selection"
      default SOUND_D2_45057_SPDIF
      depends on SOUND_D2_45057
      help
        Select D2-45057 data path.

      config SOUND_D2_45057_SPDIF
              bool "CS75XX-SPDIF"

      config SOUND_D2_45057_SSP
              bool "CS75XX-SSP"
endchoice

endmenu
```

## openwrt-2.4.2011-trunk/target/linux/ag2/files/drivers/cs752x/telephony/Kconfig
```kconfig
#
# Telephony device configuration
#
menu "Telephony support"
     depends on ARCH_GOLDENGATE && PHONE

     config PHONE_CS75XX_WRAPPER
	tristate "Cortina CS75XX phone wrapper"
	depends on ARCH_GOLDENGATE
	
     choice
	prompt "SLOT Selection"
	depends on PHONE_CS75XX_WRAPPER && CORTINA_ENGINEERING
	default SLIC_SLOT0
	
	config SLIC_SLOT0
	       bool "SLOT 0"

	config SSP_INDEX1
	       bool "SLOT 1"
     endchoice

endmenu
```

## openwrt-2.4.2011-trunk/target/linux/ag2/image/Config.in
```kconfig
config ADDITIONAL_HOST_TOOLS
       string "Additional host tools needed"
       default ""
       help
         Additional tools in ./tools/ that need to be compiled
	 on the build host to build this target.

config GB_FLASH_CONSTRUCTION
       bool "Build Flash Images"
       depends !TARGET_ROOTFS_INITRAMFS && TARGET_ag2
       default n
       help
         Build flash.bin and various software download images
	 to support the G2 platform and system upgrade.

       menu "Configuration"
       	    depends on GB_FLASH_CONSTRUCTION

       	    choice
	      prompt "Flash Profile"
	      default GB_FLASH_PROFILE_PANDROID
	      help
		Select how to construct and organize the flash.

            config GB_FLASH_PROFILE_PANDROID
       	      bool "Merge pre-build Pandroid FS with G2"
	      select TARGET_ROOTFS_SQUASHFS
	      help
	        Temporary solution until we can build the Android
		rootfs under OpenWRT.  This profile relies on an
		externally build Android FS, and folds it into
		the OpenWRT rootfs.

            config GB_FLASH_PROFILE_MTD
       	      bool "MTD mgmt - Fast but inflexible"
	      select TARGET_ROOTFS_SQUASHFS
	      help
		Kernel and rootfs images stored in flash partitions.
		This solution is inflexible in that the kernel and rootfs 
		are stored on fixed size partitions, and thus cannot
		gorw in size beyond these parition sizes.  But u-boot
		access is faster (than with jffs2).

            config GB_FLASH_PROFILE_ROOTFS_ON_DISK
       	      bool "Kernel in flash, rootfs on disk"
	      select TARGET_ROOTFS_EXT4FS
	      help
	        Kernel stored in flash, but root file system expected
		to be on attached storage, like a disk drive.  You will
		have to change CS_UBOOT_ROOTFS_ARGS for this.

            endchoice

	    config CS_UBOOT_ETHADDR0
       	      string "U-boot Networking: MAC0 Address"
       	      default "00:13:25:A0:30:42"
       	    help
	      u-boot ethaddr0

            config CS_UBOOT_ETHADDR1
       	      string "U-boot Networking: MAC1 Address"
       	      default "00:13:25:B0:30:42"
       	      help
		u-boot ethaddr1
	 
            config CS_UBOOT_ETHADDR2
       	      string "U-boot Networking: MAC2 Address"
       	      default "00:13:25:C0:30:42"
       	      help
		u-boot ethaddr2
	 	 
            config CS_UBOOT_IPADDR
       	      string "U-boot Networking: IP Address"
       	      default "192.168.61.99"
       	      help
		u-boot ipaddr

            config CS_UBOOT_NETMASK
       	      string "U-boot Networking: Netmask"
       	      default "255.255.255.0"
       	      help
		u-boot netmask

            config CS_UBOOT_SERVERIP
       	      string "U-boot Networking: Server IP"
       	      default "192.168.65.127"
       	      help
	        u-boot serverip

            config CS_UBOOT_GATEWAYIP
       	      string "U-boot Networking: Gateway IP"
       	      default "192.168.61.1"
       	      help
	        u-boot gatewayip

            config CS_UBOOT_ROOTFS_ARGS
	      string "Root Filesystem Args"
	      default "root=/dev/ram rdinit=/etc/preinit"
	      help
	        bootargs to kernel for finding rootfs

            config CS_UBOOT_MORE_ARGS
	      string "Additional Bootargs"
	      default ""
	      help
	        Additional bootargs

       endmenu
```

## openwrt-2.4.2011-trunk/target/linux/ag2/ref/defconfig
```kconfig
# Non-package opwnwrt .config stuff to add for this board,
# for all profiles.  
CONFIG_BUSYBOX_CONFIG_RESIZE=y
CONFIG_BUSYBOX_CONFIG_GETTY=y
CONFIG_BUSYBOX_CONFIG_LOGIN=y
CONFIG_PACKAGE_hotplug2=n
CONFIG_CS_UBOOT_MORE_ARGS="SB_PHY=PSXX"
CONFIG_PACKAGE_switch_config=y
CONFIG_KERNEL_PCIE_NUM_PORTS=1
#
# Virtual Ethernet Defaults
#
CONFIG_KERNEL_CS752X_VIRTUAL_NETWORK_INTERFACE=y
# CONFIG_KERNEL_CS752X_VIRTUAL_NI_CPUTAG is not set
CONFIG_KERNEL_CS752X_VIRTUAL_NI_DBLTAG=y
# CONFIG_KERNEL_CS752X_VIRTUAL_ETH0 is not set
CONFIG_KERNEL_CS752X_VIRTUAL_ETH1=y
CONFIG_KERNEL_CS752X_NR_VIRTUAL_ETH1=4
CONFIG_KERNEL_CS752X_VID_START_ETH1=100
# CONFIG_KERNEL_CS752X_VIRTUAL_ETH2 is not set
```

## openwrt-2.4.2011-trunk/target/linux/g2/android/defconfig
```kconfig
# Non-package opwnwrt .config stuff to add for this board,
# for all profiles.  
CONFIG_BUSYBOX_CONFIG_RESIZE=y
CONFIG_BUSYBOX_CONFIG_GETTY=y
CONFIG_BUSYBOX_CONFIG_LOGIN=y
# Android reboot/poweroff/halt work better than bb
# CONFIG_BUSYBOX_CONFIG_HALT is not set
```

## openwrt-2.4.2011-trunk/target/linux/g2/bhr/defconfig
```kconfig
# Non-package opwnwrt .config stuff to add for this board,
# for all profiles.  
CONFIG_BUSYBOX_CONFIG_RESIZE=y
CONFIG_BUSYBOX_CONFIG_GETTY=y
CONFIG_BUSYBOX_CONFIG_LOGIN=y
CONFIG_CS_UBOOT_MORE_ARGS="SB_PHY=PPPS consoleblank=0 mem=512M no_console_suspend=1"
CONFIG_KERNEL_PCIE_NUM_PORTS=3
CONFIG_PACKAGE_procps=y
CONFIG_KERNEL_CS75XX_PHY_ADDR_GMAC0=2
CONFIG_KERNEL_CS75XX_PHY_ADDR_GMAC2=3
# CONFIG_KERNEL_PCIE_EXTERNAL_CLOCK is not set
CONFIG_PACKAGE_kmod-leds-gpio=y
CONFIG_PACKAGE_kmod-ledtrig-timer=y
CONFIG_PACKAGE_kmod-ledtrig-usbdev=y
```
