;*********************
;JTAG DEBUGGER SET UP
;*********************
;Open CPU system window
SYSTEM
SYSTEM.RESET
SYSTEM.OPTION ENRESET OFF
SYSTEM.CPU CortexA9MPCore
;SYSTEM.CPU CortexA9
;by default the JTAG clock is set to 10Mhz
;SYSTEM.JTAGCLOCK

;**********************
;CORESIGHT SYSTEM SETUP
;***********************
;JTAG SCAN CHAIN DIAGNOSIS: If you get IR_Width = 4 (ARM7, ARM9, Cortex) or IR_Width = 5 (ARM11)
;DIAG 3400
;Read ROM Table
;AREA
;DIAG 3411

;R-T Memory Access
SYSTEM.MULTICORE MEMORYACCESSPORT 0
SYSTEM.MULTICORE DEBUGACCESSPORT 1

;Setting Core debug register access
SYSTEM.MULTICORE COREBASE APB:0x00110000

;Setting PTM
SYSTEM.MULTICORE ETMBASE APB:0x0011C000

;Setting ETB
SYSTEM.MULTICORE ETBBASE APB:0x00001000

;Setting TPIU
SYSTEM.MULTICORE TPIUBASE APB:0x00003000

;Setting Funnel
SYSTEM.MULTICORE FUNNELBASE APB:0x00004000
SYSTEM.MULTICORE ETMFUNNELPORT 0

;To activate external trace via TPIU instead into the ETB you need to set, but it is the default if there is an ETM Preprocessor connected
;Trace.Method Analyzer
;To activate the ETB
;Trace.Method ONCHIP

SYSTEM.UP

; Disable ROM Remap
d.s 0xf0000010 %l 0x0001fc01

;L2 address filtering start address, for memory swap
d.s 0xf5010c00 %l 0x00000001	; L2 controller filter start
d.s 0xf5010c04 %l 0x40000000	; L2 controller filter end [1GB]
d.s 0xf0000058 %l 0x20000040	; GLOBAL_L2_CONFIG_A : filter
d.s 0xf0000048 %l 0x00004400	; GLOBAL_ARM_CONFIG_B : filterend

d.s 0xf000003c %l 0x00000001	; Power off CPU1 in DDR training stage ?

;;;;;;;;;;;;;;;;;;;; Create Flash map  ;;;;;;;;;;;;;;;;;;;;;;;;;;
;1. Create map
; Check flash part number at http://www.lauterbach.com/frames.html?ylist.html
; e.g: Type S29GL01GS is map to code AM29S256.
; Last parameter is bus width, WORD for 16bit
FLASH.RESET
FLASH.CREATE 0xE0000000++0x40000 AM29S256 WORD

;;;;;;;;;;;;;;;;;;;;;;; Erase flash ;;;;;;;;;;;;;;;;;;;;;;;;;
;2. Erase Flash.
;FLASH.ERASE ALL ; erase all flash chip.
FLASH.ERASE 0xE0000000--0xE0040000 ; only erase bootloader ªº¦ì¸m

;;;;;;;;;;;;;;;;;;;;;;; Program content ;;;;;;;;;;;;;;;;;;;;;
;3. Start programming
FLASH.PROGRAM ALL ;
DATA.LOAD.BINARY Y:\Work\G2_0627_ASIC\g2\openwrt-2.4.2011-trunk\target\linux\g2\T32_scripts\u-boot-smp-wfi-asic.bin 0xE0000000 /WORD
FLASH.PROGRAM OFF ;Program finish

print "Program Flash OK!"
end