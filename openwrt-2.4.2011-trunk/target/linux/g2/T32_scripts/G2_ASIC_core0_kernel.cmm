; Disable ROM map
data.set 0xf0000010 %l 0x0001fc01
data.set 0xf5010c00 %l 0x00000001

;Load zImage
d.load.binary J:\Work\G2_0627_ASIC\g2\openwrt-2.4.2011-trunk\build_dir\linux-g2_fpga\linux-2.6.36\arch\arm\boot\zImage_1cpu_adma_L2 0x1600000 /verify
;d.load.elf J:\Work\G2_0627_ASIC\g2\openwrt-2.4.2011-trunk\build_dir\linux-g2_fpga\linux-2.6.36\vmlinux /nocode

r.s r1 0x33C	; mach-id
r.s r2 0x00000100	; atag position
;r.s pc 0xf6a00000	; post.bin
r.s pc 0x01600000	; zImage

; Init UART
data.set 0xf0070110 %l 0x000364e3	; Enable UART0,RX,TX,baudrate to 115200. Assume APB_CLK=100M
data.set 0xf0070118 %l 0x000001b2	; Sample rate
data.set 0xf0070120 %b 0x4F		; print 'O'
data.set 0xf0070120 %b 0x4B		; print 'K'
data.set 0xf0070120 %b 0x21		; print '!'
data.set 0xf0070120 %b 0x0D		;
data.set 0xf0070120 %b 0x0A		;

